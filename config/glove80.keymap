/*
 * Copyright (c) 2020 The ZMK Contributors
 * Copyright (c) 2025 Innaworks Development Limited, trading as MoErgo
 *
 * SPDX-License-Identifier: MIT
 */


/* THIS FILE WAS GENERATED BY GLOVE80 LAYOUT EDITOR
 *
 * This file was generated automatically. You may or may not want to
 * edit it directly.
 */

#include <behaviors.dtsi>
/* Include all behavior includes needed */
#include <dt-bindings/zmk/outputs.h>
#include <dt-bindings/zmk/keys.h>
#include <dt-bindings/zmk/bt.h>
#include <dt-bindings/zmk/rgb.h>
#include <dt-bindings/zmk/rgb_colors.h>

/* On demand includes */
#include <dt-bindings/zmk/input_transform.h>
#include <dt-bindings/zmk/pointing.h>
#include <input/processors.dtsi>

/* Helper Macros, based on https://github.com/urob/zmk-helpers/ */

#pragma once

#define ZMK_HELPER_STRINGIFY(x) #x

// Preprocessor mechanism to overload macros, cf. https://stackoverflow.com/a/27051616/6114651
#define VARGS_(_10, _9, _8, _7, _6, _5, _4, _3, _2, _1, N, ...) N
#define VARGS(...) VARGS_(__VA_ARGS__, 10, 9, 8, 7, 6, 5, 4, 3, 2, 1, 0)
#define CONCAT_(a, b) a##b
#define CONCAT(a, b) CONCAT_(a, b)

#define ZMK_BEHAVIOR_CORE_tap_dance  \
    compatible = "zmk,behavior-tap-dance"; \
    #binding-cells = <0>

#define ZMK_BEHAVIOR(name, type, ...) \
    name: name { \
        ZMK_BEHAVIOR_CORE_ ## type; \
        __VA_ARGS__ \
    };

#define ZMK_TAP_DANCE(name, ...) \
    ZMK_BEHAVIOR(name, tap_dance, __VA_ARGS__)

#define ZMK_TD_LAYER(name, layer) \
    ZMK_TAP_DANCE(name, \
        tapping-term-ms = <200>; \
        bindings = <&mo layer>, <&to layer>; \
)

/* Environment and metadata defines */
#define KB_TYPE_GLOVE_80 1
#define KB_TYPE_GO_60    2

#define KB_TYPE          KB_TYPE_GLOVE_80
#define EDITOR_HOST_OS   'M'

/* Automatically generated layer name defines */
#define LAYER_HRM_macOS 0
#define LAYER_Typing 1
#define LAYER_Autoshift 2
#define LAYER_Gaming 3
#define LAYER_Cursor 4
#define LAYER_Symbol 5
#define LAYER_Mouse 6
#define LAYER_MouseSlow 7
#define LAYER_MouseFast 8
#define LAYER_MouseWarp 9
#define LAYER_Lower 10
#define LAYER_Magic 11
#define LAYER_PySym 12

/* To deal with the situation where there is no Lower layer, to keep &lower happy */
#ifndef LAYER_Lower
#endif

/* Custom Device-tree */
/* Input Listeners */
&mmv_input_listener {
    // LAYER_MouseSlow
    LAYER_MouseSlow {
        layers = <LAYER_MouseSlow>;
        input-processors = <&zip_xy_scaler 1 9>;
    };
    // LAYER_MouseFast
    LAYER_MouseFast {
        layers = <LAYER_MouseFast>;
        input-processors = <&zip_xy_scaler 3 1>;
    };
    // LAYER_MouseWarp
    LAYER_MouseWarp {
        layers = <LAYER_MouseWarp>;
        input-processors = <&zip_xy_scaler 12 1>;
    };
};

&msc_input_listener {
    // LAYER_MouseSlow
    LAYER_MouseSlow {
        layers = <LAYER_MouseSlow>;
        input-processors = <&zip_scroll_scaler 1 9>;
    };
    // LAYER_MouseFast
    LAYER_MouseFast {
        layers = <LAYER_MouseFast>;
        input-processors = <&zip_scroll_scaler 3 1>;
    };
    // LAYER_MouseWarp
    LAYER_MouseWarp {
        layers = <LAYER_MouseWarp>;
        input-processors = <&zip_scroll_scaler 12 1>;
    };
};

/* System behavior and Macros */
/ {
    behaviors {
        ZMK_TD_LAYER(lower, LAYER_Lower)
    };
};

/ {
    macros {
        rgb_ug_status_macro: rgb_ug_status_macro {
            label = "RGB_UG_STATUS";
            compatible = "zmk,behavior-macro";
            #binding-cells = <0>;
            bindings
                = <&rgb_ug RGB_STATUS>;
        };
    };
};


/ {
#ifdef BT_DISC_CMD
    behaviors {
        bt_0: bt_0 {
            compatible = "zmk,behavior-tap-dance";
            label = "BT_0";
            #binding-cells = <0>;
            tapping-term-ms = <200>;
            bindings = <&bt_select_0>, <&bt BT_DISC 0>;
        };
        bt_1: bt_1 {
            compatible = "zmk,behavior-tap-dance";
            label = "BT_1";
            #binding-cells = <0>;
            tapping-term-ms = <200>;
            bindings = <&bt_select_1>, <&bt BT_DISC 1>;
        };
        bt_2: bt_2 {
            compatible = "zmk,behavior-tap-dance";
            label = "BT_2";
            #binding-cells = <0>;
            tapping-term-ms = <200>;
            bindings = <&bt_select_2>, <&bt BT_DISC 2>;
        };
        bt_3: bt_3 {
            compatible = "zmk,behavior-tap-dance";
            label = "BT_3";
            #binding-cells = <0>;
            tapping-term-ms = <200>;
            bindings = <&bt_select_3>, <&bt BT_DISC 3>;
        };
    };
    macros {
        bt_select_0: bt_select_0 {
            label = "BT_SELECT_0";
            compatible = "zmk,behavior-macro";
            #binding-cells = <0>;
            bindings
                = <&out OUT_BLE>,
                  <&bt BT_SEL 0>;
        };
        bt_select_1: bt_select_1 {
            label = "BT_SELECT_1";
            compatible = "zmk,behavior-macro";
            #binding-cells = <0>;
            bindings
                = <&out OUT_BLE>,
                  <&bt BT_SEL 1>;
        };
        bt_select_2: bt_select_2 {
            label = "BT_SELECT_2";
            compatible = "zmk,behavior-macro";
            #binding-cells = <0>;
            bindings
                = <&out OUT_BLE>,
                  <&bt BT_SEL 2>;
        };
        bt_select_3: bt_select_3 {
            label = "BT_SELECT_3";
            compatible = "zmk,behavior-macro";
            #binding-cells = <0>;
            bindings
                = <&out OUT_BLE>,
                  <&bt BT_SEL 3>;
        };
    };
#else
    macros {
        bt_0: bt_0 {
            label = "BT_0";
            compatible = "zmk,behavior-macro";
            #binding-cells = <0>;
            bindings
                = <&out OUT_BLE>,
                  <&bt BT_SEL 0>;
        };
        bt_1: bt_1 {
            label = "BT_1";
            compatible = "zmk,behavior-macro";
            #binding-cells = <0>;
            bindings
                = <&out OUT_BLE>,
                  <&bt BT_SEL 1>;
        };
        bt_2: bt_2 {
            label = "BT_2";
            compatible = "zmk,behavior-macro";
            #binding-cells = <0>;
            bindings
                = <&out OUT_BLE>,
                  <&bt BT_SEL 2>;
        };
        bt_3: bt_3 {
            label = "BT_3";
            compatible = "zmk,behavior-macro";
            #binding-cells = <0>;
            bindings
                = <&out OUT_BLE>,
                  <&bt BT_SEL 3>;
        };
    };
#endif
};

/ {
    behaviors {
        magic: magic {
            compatible = "zmk,behavior-hold-tap";
            label = "MAGIC_HOLD_TAP";
            #binding-cells = <2>;
            flavor = "tap-preferred";
            tapping-term-ms = <200>;
            bindings = <&mo>, <&rgb_ug_status_macro>;
        };
    };
};


/* Key positions */

#define POS_LH_C6R1 0
#define POS_LH_C5R1 1
#define POS_LH_C4R1 2
#define POS_LH_C3R1 3
#define POS_LH_C2R1 4
#define POS_RH_C2R1 5
#define POS_RH_C3R1 6
#define POS_RH_C4R1 7
#define POS_RH_C5R1 8
#define POS_RH_C6R1 9
#define POS_LH_C6R2 10
#define POS_LH_C5R2 11
#define POS_LH_C4R2 12
#define POS_LH_C3R2 13
#define POS_LH_C2R2 14
#define POS_LH_C1R2 15
#define POS_RH_C1R2 16
#define POS_RH_C2R2 17
#define POS_RH_C3R2 18
#define POS_RH_C4R2 19
#define POS_RH_C5R2 20
#define POS_RH_C6R2 21
#define POS_LH_C6R3 22
#define POS_LH_C5R3 23
#define POS_LH_C4R3 24
#define POS_LH_C3R3 25
#define POS_LH_C2R3 26
#define POS_LH_C1R3 27
#define POS_RH_C1R3 28
#define POS_RH_C2R3 29
#define POS_RH_C3R3 30
#define POS_RH_C4R3 31
#define POS_RH_C5R3 32
#define POS_RH_C6R3 33
#define POS_LH_C6R4 34
#define POS_LH_C5R4 35
#define POS_LH_C4R4 36
#define POS_LH_C3R4 37
#define POS_LH_C2R4 38
#define POS_LH_C1R4 39
#define POS_RH_C1R4 40
#define POS_RH_C2R4 41
#define POS_RH_C3R4 42
#define POS_RH_C4R4 43
#define POS_RH_C5R4 44
#define POS_RH_C6R4 45
#define POS_LH_C6R5 46
#define POS_LH_C5R5 47
#define POS_LH_C4R5 48
#define POS_LH_C3R5 49
#define POS_LH_C2R5 50
#define POS_LH_C1R5 51
#define POS_LH_T1 52
#define POS_LH_T2 53
#define POS_LH_T3 54
#define POS_RH_T3 55
#define POS_RH_T2 56
#define POS_RH_T1 57
#define POS_RH_C1R5 58
#define POS_RH_C2R5 59
#define POS_RH_C3R5 60
#define POS_RH_C4R5 61
#define POS_RH_C5R5 62
#define POS_RH_C6R5 63
#define POS_LH_C6R6 64
#define POS_LH_C5R6 65
#define POS_LH_C4R6 66
#define POS_LH_C3R6 67
#define POS_LH_C2R6 68
#define POS_LH_T4 69
#define POS_LH_T5 70
#define POS_LH_T6 71
#define POS_RH_T6 72
#define POS_RH_T5 73
#define POS_RH_T4 74
#define POS_RH_C2R6 75
#define POS_RH_C3R6 76
#define POS_RH_C4R6 77
#define POS_RH_C5R6 78
#define POS_RH_C6R6 79


/* Custom Defined Behaviors */
/ {

};

/* Generated input processors */


/* Automatically generated macro definitions */
/ {
    macros {

        // AutoShift Helper- &AS main macro is chained to &AS_HT hold tap and &AS_Shifted macro - TailorKey
        AS_Shifted_v1_TKZ: AS_Shifted_v1_TKZ {
            label = "&AS_SHIFTED_V1_TKZ";
            compatible = "zmk,behavior-macro-one-param";
            #binding-cells = <1>;
            tap-ms = <0>;
            wait-ms = <0>;
            bindings = <&macro_press>
                , <&kp LSHFT>
                , <&macro_tap>
                , <&macro_param_1to1>
                , <&kp MACRO_PLACEHOLDER>
                , <&macro_release>
                , <&kp LSHFT>;
        };

        // AutoShift (Assign &AS to a Key) - &AS main macro is chained to &AS_HT hold tap and &AS_Shifted macro - TailorKey
        AS_v1_TKZ: AS_v1_TKZ {
            label = "&AS_V1_TKZ";
            compatible = "zmk,behavior-macro-one-param";
            #binding-cells = <1>;
            tap-ms = <0>;
            wait-ms = <0>;
            bindings = <&macro_press>
                , <&macro_param_1to1>
                , <&macro_param_1to2>
                , <&AS_HT_v2_TKZ MACRO_PLACEHOLDER MACRO_PLACEHOLDER>
                , <&macro_pause_for_release>
                , <&macro_release>
                , <&macro_param_1to1>
                , <&macro_param_1to2>
                , <&AS_HT_v2_TKZ MACRO_PLACEHOLDER MACRO_PLACEHOLDER>;
        };

        // Cursor Layer - Extent Line (seq) - TailorKey
        cur_EXTEND_LINE_macos_v1_TKZ: cur_EXTEND_LINE_macos_v1_TKZ {
            label = "&CUR_EXTEND_LINE_MACOS_V1_TKZ";
            compatible = "zmk,behavior-macro";
            #binding-cells = <0>;
            tap-ms = <1>;
            wait-ms = <1>;
            bindings = <&kp LG(LS(RIGHT))>;
        };

        // Cursor Layer - Extend Word (seq) - TailorKey
        cur_EXTEND_WORD_macos_v1_TKZ: cur_EXTEND_WORD_macos_v1_TKZ {
            label = "&CUR_EXTEND_WORD_MACOS_V1_TKZ";
            compatible = "zmk,behavior-macro";
            #binding-cells = <0>;
            tap-ms = <1>;
            wait-ms = <1>;
            bindings = <&kp LA(LS(RIGHT))>;
        };

        // Cursor Layer macos - Select Line (seq) - TailorKey
        cur_SELECT_LINE_macos_v1_TKZ: cur_SELECT_LINE_macos_v1_TKZ {
            label = "&CUR_SELECT_LINE_MACOS_V1_TKZ";
            compatible = "zmk,behavior-macro";
            #binding-cells = <0>;
            tap-ms = <1>;
            wait-ms = <1>;
            bindings = <&kp LG(LEFT)>
                , <&kp LG(LS(RIGHT))>;
        };

        // Cursor Layer - Select None (seq) - TailorKey
        cur_SELECT_NONE_v1_TKZ: cur_SELECT_NONE_v1_TKZ {
            label = "&CUR_SELECT_NONE_V1_TKZ";
            compatible = "zmk,behavior-macro";
            #binding-cells = <0>;
            tap-ms = <1>;
            wait-ms = <1>;
            bindings = <&kp DOWN>
                , <&kp UP>
                , <&kp RIGHT>
                , <&kp LEFT>;
        };

        // Cursor Layer - Select Word (seq) - TailorKey
        cur_SELECT_WORD_macos_v1_TKZ: cur_SELECT_WORD_macos_v1_TKZ {
            label = "&CUR_SELECT_WORD_MACOS_V1_TKZ";
            compatible = "zmk,behavior-macro";
            #binding-cells = <0>;
            tap-ms = <1>;
            wait-ms = <1>;
            bindings = <&kp LA(LEFT)>
                , <&kp LA(LS(RIGHT))>;
        };

        // mod_tab_switcher_chord -  TailorKey
        mod_tab_chord_v2_TKZ: mod_tab_chord_v2_TKZ {
            label = "&MOD_TAB_CHORD_V2_TKZ";
            compatible = "zmk,behavior-macro-two-param";
            #binding-cells = <2>;
            tap-ms = <0>;
            wait-ms = <0>;
            bindings = <&macro_press>
                , <&macro_param_2to1>
                , <&mo MACRO_PLACEHOLDER>
                , <&macro_press>
                , <&macro_param_1to1>
                , <&mod_tab_v1_TKZ MACRO_PLACEHOLDER>
                , <&macro_pause_for_release>
                , <&macro_release>
                , <&macro_param_1to1>
                , <&mod_tab_v1_TKZ MACRO_PLACEHOLDER>
                , <&macro_release>
                , <&macro_param_2to1>
                , <&mo MACRO_PLACEHOLDER>;
        };

        // mod_tab_switcher - TailorKey
        //
        //
        mod_tab_v1_TKZ: mod_tab_v1_TKZ {
            label = "&MOD_TAB_V1_TKZ";
            compatible = "zmk,behavior-macro-one-param";
            #binding-cells = <1>;
            tap-ms = <0>;
            wait-ms = <0>;
            bindings = <&macro_press>
                , <&macro_param_1to1>
                , <&kp MACRO_PLACEHOLDER>
                , <&macro_tap>
                , <&kp TAB>
                , <&macro_pause_for_release>
                , <&macro_release>
                , <&macro_param_1to1>
                , <&kp MACRO_PLACEHOLDER>;
        };

        // Symbol layer dot dot
        symb_dotdot_v1_TKZ: symb_dotdot_v1_TKZ {
            label = "&SYMB_DOTDOT_V1_TKZ";
            compatible = "zmk,behavior-macro";
            #binding-cells = <0>;
            tap-ms = <0>;
            wait-ms = <0>;
            bindings = <&macro_tap>
                , <&kp DOT>
                , <&kp DOT>;
        };
    };
};

/* Automatically generated behavior definitions */
/ {
    behaviors {


        // AutoShift Helper - &AS main macro is chained to &AS_HT hold tap and &AS_Shifted macro. For faster typists, it is recommended to decrease the tapping-term-ms value. A suggested value is 135 ms.
        // More: https://github.com/nickcoutsos/keymap-editor/wiki/Autoshift-using-ZMK-behaviors
        AS_HT_v2_TKZ: AS_HT_v2_TKZ {
            compatible = "zmk,behavior-hold-tap";
            #binding-cells = <2>;
            tapping-term-ms = <190>;
            bindings = <&AS_Shifted_v1_TKZ>, <&kp>;
            flavor = "tap-preferred";
        };

        // Auto-gen left HRM (v3)
        HRM_left_index: HRM_left_index {
            compatible = "zmk,behavior-hold-tap";
            #binding-cells = <2>;
            tapping-term-ms = <180>;
            bindings = <&kp>, <&kp>;
            flavor = "tap-preferred";
            quick-tap-ms = <300>;
            require-prior-idle-ms = <100>;
            hold-trigger-key-positions = <POS_RH_C2R1 POS_RH_C3R1 POS_RH_C4R1 POS_RH_C5R1 POS_RH_C6R1 POS_RH_C1R2 POS_RH_C2R2 POS_RH_C3R2 POS_RH_C4R2 POS_RH_C5R2 POS_RH_C6R2 POS_RH_C1R3 POS_RH_C2R3 POS_RH_C3R3 POS_RH_C4R3 POS_RH_C5R3 POS_RH_C6R3 POS_RH_C1R4 POS_RH_C2R4 POS_RH_C3R4 POS_RH_C4R4 POS_RH_C5R4 POS_RH_C6R4 POS_RH_C1R5 POS_RH_C2R5 POS_RH_C3R5 POS_RH_C4R5 POS_RH_C5R5 POS_RH_C6R5 POS_RH_C2R6 POS_RH_C3R6 POS_RH_C4R6 POS_RH_C5R6 POS_RH_C6R6>;
            hold-trigger-on-release;
        };

        // Auto-gen left HRM (v3)
        HRM_left_middy: HRM_left_middy {
            compatible = "zmk,behavior-hold-tap";
            #binding-cells = <2>;
            tapping-term-ms = <210>;
            bindings = <&kp>, <&kp>;
            flavor = "tap-preferred";
            quick-tap-ms = <300>;
            require-prior-idle-ms = <150>;
            hold-trigger-key-positions = <POS_RH_C2R1 POS_RH_C3R1 POS_RH_C4R1 POS_RH_C5R1 POS_RH_C6R1 POS_RH_C1R2 POS_RH_C2R2 POS_RH_C3R2 POS_RH_C4R2 POS_RH_C5R2 POS_RH_C6R2 POS_RH_C1R3 POS_RH_C2R3 POS_RH_C3R3 POS_RH_C4R3 POS_RH_C5R3 POS_RH_C6R3 POS_RH_C1R4 POS_RH_C2R4 POS_RH_C3R4 POS_RH_C4R4 POS_RH_C5R4 POS_RH_C6R4 POS_RH_C1R5 POS_RH_C2R5 POS_RH_C3R5 POS_RH_C4R5 POS_RH_C5R5 POS_RH_C6R5 POS_RH_C2R6 POS_RH_C3R6 POS_RH_C4R6 POS_RH_C5R6 POS_RH_C6R6>;
            hold-trigger-on-release;
        };

        // Auto-gen left HRM (v3)
        HRM_left_pinky: HRM_left_pinky {
            compatible = "zmk,behavior-hold-tap";
            #binding-cells = <2>;
            tapping-term-ms = <270>;
            bindings = <&kp>, <&kp>;
            flavor = "tap-preferred";
            quick-tap-ms = <300>;
            require-prior-idle-ms = <150>;
            hold-trigger-key-positions = <POS_RH_C2R1 POS_RH_C3R1 POS_RH_C4R1 POS_RH_C5R1 POS_RH_C6R1 POS_RH_C1R2 POS_RH_C2R2 POS_RH_C3R2 POS_RH_C4R2 POS_RH_C5R2 POS_RH_C6R2 POS_RH_C1R3 POS_RH_C2R3 POS_RH_C3R3 POS_RH_C4R3 POS_RH_C5R3 POS_RH_C6R3 POS_RH_C1R4 POS_RH_C2R4 POS_RH_C3R4 POS_RH_C4R4 POS_RH_C5R4 POS_RH_C6R4 POS_RH_C1R5 POS_RH_C2R5 POS_RH_C3R5 POS_RH_C4R5 POS_RH_C5R5 POS_RH_C6R5 POS_RH_C2R6 POS_RH_C3R6 POS_RH_C4R6 POS_RH_C5R6 POS_RH_C6R6>;
            hold-trigger-on-release;
        };

        // Auto-gen left HRM (v3)
        HRM_left_ring: HRM_left_ring {
            compatible = "zmk,behavior-hold-tap";
            #binding-cells = <2>;
            tapping-term-ms = <240>;
            bindings = <&kp>, <&kp>;
            flavor = "tap-preferred";
            quick-tap-ms = <300>;
            require-prior-idle-ms = <150>;
            hold-trigger-key-positions = <POS_RH_C2R1 POS_RH_C3R1 POS_RH_C4R1 POS_RH_C5R1 POS_RH_C6R1 POS_RH_C1R2 POS_RH_C2R2 POS_RH_C3R2 POS_RH_C4R2 POS_RH_C5R2 POS_RH_C6R2 POS_RH_C1R3 POS_RH_C2R3 POS_RH_C3R3 POS_RH_C4R3 POS_RH_C5R3 POS_RH_C6R3 POS_RH_C1R4 POS_RH_C2R4 POS_RH_C3R4 POS_RH_C4R4 POS_RH_C5R4 POS_RH_C6R4 POS_RH_C1R5 POS_RH_C2R5 POS_RH_C3R5 POS_RH_C4R5 POS_RH_C5R5 POS_RH_C6R5 POS_RH_C2R6 POS_RH_C3R6 POS_RH_C4R6 POS_RH_C5R6 POS_RH_C6R6>;
            hold-trigger-on-release;
        };

        // Auto-gen right HRM (v3)
        HRM_right_index: HRM_right_index {
            compatible = "zmk,behavior-hold-tap";
            #binding-cells = <2>;
            tapping-term-ms = <180>;
            bindings = <&kp>, <&kp>;
            flavor = "tap-preferred";
            quick-tap-ms = <300>;
            require-prior-idle-ms = <100>;
            hold-trigger-key-positions = <POS_LH_C6R1 POS_LH_C5R1 POS_LH_C4R1 POS_LH_C3R1 POS_LH_C2R1 POS_LH_C6R2 POS_LH_C5R2 POS_LH_C4R2 POS_LH_C3R2 POS_LH_C2R2 POS_LH_C1R2 POS_LH_C6R3 POS_LH_C5R3 POS_LH_C4R3 POS_LH_C3R3 POS_LH_C2R3 POS_LH_C1R3 POS_LH_C6R4 POS_LH_C5R4 POS_LH_C4R4 POS_LH_C3R4 POS_LH_C2R4 POS_LH_C1R4 POS_LH_C6R5 POS_LH_C5R5 POS_LH_C4R5 POS_LH_C3R5 POS_LH_C2R5 POS_LH_C1R5 POS_LH_C6R6 POS_LH_C5R6 POS_LH_C4R6 POS_LH_C3R6 POS_LH_C2R6>;
            hold-trigger-on-release;
        };

        // Auto-gen right HRM (v3)
        HRM_right_middy: HRM_right_middy {
            compatible = "zmk,behavior-hold-tap";
            #binding-cells = <2>;
            tapping-term-ms = <210>;
            bindings = <&kp>, <&kp>;
            flavor = "tap-preferred";
            quick-tap-ms = <300>;
            require-prior-idle-ms = <150>;
            hold-trigger-key-positions = <POS_LH_C6R1 POS_LH_C5R1 POS_LH_C4R1 POS_LH_C3R1 POS_LH_C2R1 POS_LH_C6R2 POS_LH_C5R2 POS_LH_C4R2 POS_LH_C3R2 POS_LH_C2R2 POS_LH_C1R2 POS_LH_C6R3 POS_LH_C5R3 POS_LH_C4R3 POS_LH_C3R3 POS_LH_C2R3 POS_LH_C1R3 POS_LH_C6R4 POS_LH_C5R4 POS_LH_C4R4 POS_LH_C3R4 POS_LH_C2R4 POS_LH_C1R4 POS_LH_C6R5 POS_LH_C5R5 POS_LH_C4R5 POS_LH_C3R5 POS_LH_C2R5 POS_LH_C1R5 POS_LH_C6R6 POS_LH_C5R6 POS_LH_C4R6 POS_LH_C3R6 POS_LH_C2R6>;
            hold-trigger-on-release;
        };

        // Auto-gen right HRM (v3)
        HRM_right_pinky: HRM_right_pinky {
            compatible = "zmk,behavior-hold-tap";
            #binding-cells = <2>;
            tapping-term-ms = <270>;
            bindings = <&kp>, <&kp>;
            flavor = "tap-preferred";
            quick-tap-ms = <300>;
            require-prior-idle-ms = <150>;
            hold-trigger-key-positions = <POS_LH_C6R1 POS_LH_C5R1 POS_LH_C4R1 POS_LH_C3R1 POS_LH_C2R1 POS_LH_C6R2 POS_LH_C5R2 POS_LH_C4R2 POS_LH_C3R2 POS_LH_C2R2 POS_LH_C1R2 POS_LH_C6R3 POS_LH_C5R3 POS_LH_C4R3 POS_LH_C3R3 POS_LH_C2R3 POS_LH_C1R3 POS_LH_C6R4 POS_LH_C5R4 POS_LH_C4R4 POS_LH_C3R4 POS_LH_C2R4 POS_LH_C1R4 POS_LH_C6R5 POS_LH_C5R5 POS_LH_C4R5 POS_LH_C3R5 POS_LH_C2R5 POS_LH_C1R5 POS_LH_C6R6 POS_LH_C5R6 POS_LH_C4R6 POS_LH_C3R6 POS_LH_C2R6>;
            hold-trigger-on-release;
        };

        // Auto-gen right HRM (v3)
        HRM_right_ring: HRM_right_ring {
            compatible = "zmk,behavior-hold-tap";
            #binding-cells = <2>;
            tapping-term-ms = <240>;
            bindings = <&kp>, <&kp>;
            flavor = "tap-preferred";
            quick-tap-ms = <300>;
            require-prior-idle-ms = <150>;
            hold-trigger-key-positions = <POS_LH_C6R1 POS_LH_C5R1 POS_LH_C4R1 POS_LH_C3R1 POS_LH_C2R1 POS_LH_C6R2 POS_LH_C5R2 POS_LH_C4R2 POS_LH_C3R2 POS_LH_C2R2 POS_LH_C1R2 POS_LH_C6R3 POS_LH_C5R3 POS_LH_C4R3 POS_LH_C3R3 POS_LH_C2R3 POS_LH_C1R3 POS_LH_C6R4 POS_LH_C5R4 POS_LH_C4R4 POS_LH_C3R4 POS_LH_C2R4 POS_LH_C1R4 POS_LH_C6R5 POS_LH_C5R5 POS_LH_C4R5 POS_LH_C3R5 POS_LH_C2R5 POS_LH_C1R5 POS_LH_C6R6 POS_LH_C5R6 POS_LH_C4R6 POS_LH_C3R6 POS_LH_C2R6>;
            hold-trigger-on-release;
        };

        // space_layer_access - TailorKey
        space_v3_TKZ: space_v3_TKZ {
            compatible = "zmk,behavior-hold-tap";
            #binding-cells = <2>;
            tapping-term-ms = <200>;
            bindings = <&mo>, <&kp>;
            flavor = "balanced";
            quick-tap-ms = <150>;
            require-prior-idle-ms = <0>;
        };

        // thumb_layer_access - TailorKey
        thumb_v2_TKZ: thumb_v2_TKZ {
            compatible = "zmk,behavior-hold-tap";
            #binding-cells = <2>;
            tapping-term-ms = <200>;
            bindings = <&mo>, <&kp>;
            flavor = "balanced";
            quick-tap-ms = <300>;
            require-prior-idle-ms = <0>;
        };

        esc_screenshot: esc_screenshot {
            compatible = "zmk,behavior-hold-tap";
            #binding-cells = <2>;
            tapping-term-ms = <270>;
            bindings = <&kp>, <&kp>;
            flavor = "tap-preferred";
            require-prior-idle-ms = <150>;
        };
    };
};

/* Automatically generated combos definitions */
/ {
    combos {
        compatible = "zmk,combos";

        // F11 on RH_C5 and RH_R1+R2 - TailorKey
        combo_F11_v1_TKZ {
            timeout-ms = <50>;
            key-positions = <POS_RH_C5R1 POS_RH_C5R2>;
            bindings = <&kp F11>;
            layers = <LAYER_HRM_macOS LAYER_Autoshift>;
        };

        // F12 on RH_C6 and RH_R1+R2 - TailorKey
        combo_F12_v1_TKZ {
            timeout-ms = <50>;
            key-positions = <POS_RH_C6R1 POS_RH_C6R2>;
            bindings = <&kp F12>;
            layers = <LAYER_HRM_macOS LAYER_Autoshift>;
        };

        // GE - meh_ACS_right
//
        combo_right_meh_ACS_v1_TKZ {
            key-positions = <POS_RH_T2 POS_RH_T5>;
            bindings = <&kp LA(LC(LSHFT))>;
            layers = <LAYER_HRM_macOS LAYER_Autoshift>;
        };

        // GE - combo_gaming_layer_toggle
        combo_gaming_layer_toggle_v1_TKZ {
            timeout-ms = <50>;
            key-positions = <POS_LH_C1R5 POS_LH_C2R6>;
            bindings = <&tog LAYER_Gaming>;
            layers = <LAYER_HRM_macOS LAYER_Gaming>;
        };

        // GE - combo_caps_lock_right
        combo_right_caps_lock_v1_TKZ {
            key-positions = <POS_RH_T2 POS_RH_T6>;
            bindings = <&kp CAPS>;
            layers = <LAYER_HRM_macOS LAYER_Autoshift>;
        };

        // GE - combo_caps_lock_left
        combo_left_caps_lock_v1_TKZ {
            key-positions = <POS_LH_T6 POS_LH_T2>;
            bindings = <&kp CAPS>;
            layers = <LAYER_HRM_macOS LAYER_Autoshift>;
        };

        // GE - combo_alt_tab_switcher_left
//
        combo_left_alt_tab_switcher_v1_TKZ {
            key-positions = <POS_LH_T3 POS_LH_T6>;
            bindings = <&mod_tab_chord_v2_TKZ LALT LAYER_Cursor>;
            layers = <LAYER_HRM_macOS LAYER_Autoshift>;
        };

        // GE - combo_ctrl_tab_switcher_left
//
        combo_left_ctrl_tab_switcher_v1_TKZ {
            key-positions = <POS_LH_T2 POS_LH_T5>;
            bindings = <&mod_tab_chord_v2_TKZ LCTRL LAYER_Cursor>;
            layers = <LAYER_HRM_macOS LAYER_Autoshift>;
        };

        // GE - combo_win_tab_switcher_left
        combo_left_win_tab_switcher_v1_TKZ {
            key-positions = <POS_LH_T1 POS_LH_T4>;
            bindings = <&mod_tab_chord_v2_TKZ LGUI LAYER_Cursor>;
            layers = <LAYER_HRM_macOS LAYER_Autoshift>;
        };

        // GE - combo_caps_word_right
        combo_right_caps_word_v1_TKZ {
            key-positions = <POS_RH_T5 POS_RH_T4>;
            bindings = <&caps_word>;
            layers = <LAYER_HRM_macOS LAYER_Autoshift>;
        };

        // GE - combo_caps_word_left
        combo_left_caps_word_v1_TKZ {
            key-positions = <POS_LH_T5 POS_LH_T4>;
            bindings = <&caps_word>;
            layers = <LAYER_HRM_macOS LAYER_Autoshift>;
        };
    };
};

/* Automatically generated keymap */
/ {
    keymap {
        compatible = "zmk,keymap";


        layer_HRM_macOS {
            bindings = <
                    &mt F1 C_BRI_DN          &mt F2 C_BRI_UP          &mt F3 C_PREV           &mt F4 C_NEXT              &mt F5 C_PP                                                                                                                                                                                                    &mt F6 C_MUTE          &mt F7 C_VOL_DN         &mt F8 C_VOL_UP                       &kp F9    &kp F10
                          &kp EQUAL                   &kp N1                 &kp N2                  &kp N3                   &kp N4  &kp N5                                                                                                                                                                         &kp N6                    &kp N7                   &kp N8                  &kp N9                       &kp N0  &kp MINUS
                            &kp TAB                    &kp Q                  &kp W                   &kp E                    &kp R   &kp T                                                                                                                                                                          &kp Y                     &kp U                    &kp I                   &kp O                        &kp P   &kp BSLH
 &esc_screenshot LC(LS(LG(N4))) ESC  &HRM_left_pinky LCTRL A  &HRM_left_ring LALT S  &HRM_left_middy LGUI D  &HRM_left_index LSHFT F   &kp G                                                                                                                                               &esc_screenshot LS(LG(LC(N3))) H  &HRM_right_index RSHFT J  &HRM_right_middy RGUI K  &HRM_right_ring LALT L  &HRM_right_pinky RCTRL SEMI    &kp SQT
                          &kp GRAVE                    &kp Z                  &kp X                   &kp C                    &kp V   &kp B  &mo LAYER_PySym                        &kp LCTRL         &lower  &kp LCTRL                       &kp RGUI                         &kp RSHFT                             &kp N                     &kp M                &kp COMMA                 &kp DOT                     &kp FSLH  &kp PG_UP
               &magic LAYER_Magic 0                 &kp HOME                &kp END                &kp LEFT                &kp RIGHT                 &kp LGUI  &thumb_v2_TKZ LAYER_Cursor BSPC  &mt RET SPACE   &kp RALT  &thumb_v2_TKZ LAYER_Mouse RET  &space_v3_TKZ LAYER_Symbol SPACE                                                      &kp UP                 &kp DOWN                &kp LBKT                     &kp RBKT  &kp PG_DN
            >;
        };

        layer_Typing {
            bindings = <
               &trans  &trans  &trans  &trans  &trans                                                                  &trans  &trans  &trans    &trans  &trans
               &trans  &trans  &trans  &trans  &trans  &trans                                                  &trans  &trans  &trans  &trans    &trans  &trans
               &trans  &trans  &trans  &trans  &trans  &trans                                                  &trans  &trans  &trans  &trans    &trans  &trans
               &trans   &kp A   &kp S   &kp D   &kp F  &trans                                                  &trans   &kp J   &kp K   &kp L  &kp SEMI  &trans
               &trans  &trans  &trans  &trans  &trans  &trans  &trans  &trans  &trans  &trans  &trans  &trans  &trans  &trans  &trans  &trans    &trans  &trans
 &magic LAYER_Magic 0  &trans  &trans  &trans  &trans          &trans  &trans  &trans  &trans  &trans  &trans          &trans  &trans  &trans    &trans  &trans
            >;
        };

        layer_Autoshift {
            bindings = <
               &trans         &trans         &trans         &trans         &trans                                                                                       &trans            &trans           &trans           &trans            &trans
     &AS_v1_TKZ EQUAL  &AS_v1_TKZ N1  &AS_v1_TKZ N2  &AS_v1_TKZ N3  &AS_v1_TKZ N4  &AS_v1_TKZ N5                                                  &AS_v1_TKZ N6  &AS_v1_TKZ N7     &AS_v1_TKZ N8    &AS_v1_TKZ N9    &AS_v1_TKZ N0  &AS_v1_TKZ MINUS
               &trans   &AS_v1_TKZ Q   &AS_v1_TKZ W   &AS_v1_TKZ E   &AS_v1_TKZ R   &AS_v1_TKZ T                                                   &AS_v1_TKZ Y   &AS_v1_TKZ U      &AS_v1_TKZ I     &AS_v1_TKZ O     &AS_v1_TKZ P   &AS_v1_TKZ BSLH
               &trans   &AS_v1_TKZ A   &AS_v1_TKZ S   &AS_v1_TKZ D   &AS_v1_TKZ F   &AS_v1_TKZ G                                                   &AS_v1_TKZ H   &AS_v1_TKZ J      &AS_v1_TKZ K     &AS_v1_TKZ L  &AS_v1_TKZ SEMI    &AS_v1_TKZ SQT
     &AS_v1_TKZ GRAVE   &AS_v1_TKZ Z   &AS_v1_TKZ X   &AS_v1_TKZ C   &AS_v1_TKZ V   &AS_v1_TKZ B  &trans  &trans  &trans  &trans  &trans  &trans   &AS_v1_TKZ N   &AS_v1_TKZ M  &AS_v1_TKZ COMMA   &AS_v1_TKZ DOT  &AS_v1_TKZ FSLH            &trans
 &magic LAYER_Magic 0         &trans         &trans         &trans         &trans                 &trans  &trans  &trans  &trans  &trans  &trans                        &trans            &trans  &AS_v1_TKZ LBKT  &AS_v1_TKZ RBKT            &trans
            >;
        };

        layer_Gaming {
            bindings = <
 &kp ESC      &kp P   &kp O   &kp N  &kp BSPC                                                                                   &kp F1     &kp F2    &kp F3     &kp F4     &kp F5
   &kp M     &kp N6  &kp N7  &kp N8    &kp N9  &kp N0                                                                &kp F6     &kp F7     &kp F8    &kp F9    &kp F10    &kp F11
   &kp I     &kp N1  &kp N2  &kp N3    &kp N4  &kp N5                                                                 &kp Y      &kp U      &kp I     &kp O      &kp P    &kp F12
   &kp T    &kp TAB   &kp Q   &kp W     &kp E   &kp R                                                                 &kp H      &kp J      &kp K     &kp L   &kp SEMI    &kp SQT
   &kp G  &kp LSHFT   &kp A   &kp S     &kp D   &kp F  &kp LSHFT   &kp LALT    &kp V   &kp ESC    &kp UP    &kp RET   &kp N      &kp M  &kp COMMA   &kp DOT   &kp FSLH   &kp BSLH
   &kp B  &kp LCTRL   &kp Z   &kp X     &kp C          &kp SPACE  &kp LCTRL  &kp RET  &kp LEFT  &kp DOWN  &kp RIGHT          &kp MINUS   &kp LBKT  &kp RBKT  &kp EQUAL  &kp GRAVE
            >;
        };

        layer_Cursor {
            bindings = <
     &none      &none                          &none                          &none      &none                                                                                                                                                  &none          &none          &none      &none      &none
     &none    &kp ESC                        &kp INS                    &kp LS(TAB)    &kp DEL  &kp LG(LS(N4))                                                                                                                     &none        &none          &none          &none      &none      &none
     &none    &kp RET                      &kp SPACE                        &kp TAB   &kp BSPC       &kp LG(X)                                                                                                                 &kp LG(X)  &kp LS(TAB)      &kp LG(Z)  &kp LG(LS(Z))    &kp TAB      &none
 &sk LSHFT  &kp LCTRL                       &kp LALT                       &kp LGUI  &kp LSHFT       &kp LG(C)                                                                                                                 &kp LG(C)     &kp LEFT         &kp UP       &kp DOWN  &kp RIGHT  &sk RSHFT
 &kp LG(L)  &kp LG(A)  &cur_SELECT_LINE_macos_v1_TKZ  &cur_SELECT_WORD_macos_v1_TKZ  &kp LG(F)       &kp LG(V)   &none   &none   &none  &cur_SELECT_NONE_v1_TKZ  &cur_EXTEND_LINE_macos_v1_TKZ  &cur_EXTEND_WORD_macos_v1_TKZ  &kp LG(V)     &kp HOME      &kp PG_UP      &kp PG_DN    &kp END  &kp LG(L)
 &kp LG(K)  &kp LG(Z)                  &kp LG(LS(Z))                  &kp LG(LS(G))  &kp LG(G)                   &none   &none   &none                &kp LG(A)  &cur_SELECT_LINE_macos_v1_TKZ  &cur_SELECT_WORD_macos_v1_TKZ               &kp LG(F)  &kp LG(LS(G))      &kp LG(G)  &kp LC(H)  &kp LG(K)
            >;
        };

        layer_Symbol {
            bindings = <
               &none          &none         &none                 &none          &none                                                                                                                   &none        &none      &none     &none   &none
               &none      &kp GRAVE    &kp LS(N9)            &kp LS(N0)       &kp SEMI     &kp COMMA                                                                               &none                 &none        &none      &none     &none   &none
          &kp LS(N1)       &kp LBKT  &kp LS(LBKT)          &kp LS(RBKT)       &kp RBKT  &kp LS(FSLH)                                                                           &kp GRAVE               &kp DEL  &kp LS(TAB)    &kp INS   &kp ESC   &none
          &kp LS(N3)     &kp LS(N6)     &kp EQUAL         &kp LS(MINUS)     &kp LS(N4)    &kp LS(N8)                                                                &kp LS(SINGLE_QUOTE)              &kp BSPC      &kp TAB  &kp SPACE   &kp RET   &none
       &kp LS(GRAVE)  &kp LS(COMMA)  &kp LS(BSLH)             &kp MINUS    &kp LS(DOT)      &kp FSLH    &kp BSLH       &kp DOT  &kp LS(N8)   &none   &none   &none               &kp SQT  &kp LS(SINGLE_QUOTE)      &kp SQT  &kp GRAVE  &kp BSLH   &none
 &symb_dotdot_v1_TKZ     &kp LS(N7)       &kp SQT  &kp LS(SINGLE_QUOTE)  &kp LS(EQUAL)                &kp LS(N5)  &kp LS(SEMI)  &kp LS(N2)   &none   &none   &none                                   &sk RSHFT    &sk RCTRL   &sk RALT  &sk RGUI   &none
            >;
        };

        layer_Mouse {
            bindings = <
  &none           &none                &none                &none                &none                                                                                                                 &none                &none                &none            &none     &none
  &none           &none                &none                &none                &none           &none                                                                            &none                &none                &none                &none            &none     &none
  &none           &none       &msc SCRL_LEFT         &mmv MOVE_UP      &msc SCRL_RIGHT           &none                                                                   &msc SCRL_LEFT            &mkp LCLK            &mkp MCLK            &mkp RCLK  &msc SCRL_RIGHT     &none
  &none    &msc SCRL_UP       &mmv MOVE_LEFT       &mmv MOVE_DOWN      &mmv MOVE_RIGHT    &msc SCRL_UP                                                                     &msc SCRL_UP  &mo LAYER_MouseFast  &mo LAYER_MouseWarp  &mo LAYER_MouseSlow        &kp K_APP  &mkp MB4
  &none  &msc SCRL_DOWN  &mo LAYER_MouseSlow  &mo LAYER_MouseWarp  &mo LAYER_MouseFast  &msc SCRL_DOWN  &mkp MCLK  &kp K_APP  &mkp MB5  &kp LG(X)  &kp LG(C)  &kp LG(V)  &msc SCRL_DOWN       &mmv MOVE_LEFT         &mmv MOVE_UP       &mmv MOVE_DOWN  &mmv MOVE_RIGHT  &mkp MB5
  &none           &none            &kp LG(X)            &kp LG(C)            &kp LG(V)                  &mkp LCLK  &mkp RCLK  &mkp MB4      &none      &none      &none                            &kp RSHFT            &kp RCTRL             &kp RALT         &kp RGUI     &none
            >;
        };

        layer_MouseSlow {
            bindings = <
 &trans  &trans  &trans  &trans  &trans                                                                  &trans  &trans  &trans  &trans  &trans
 &trans  &trans  &trans  &trans  &trans  &trans                                                  &trans  &trans  &trans  &trans  &trans  &trans
 &trans  &trans  &trans  &trans  &trans  &trans                                                  &trans  &trans  &trans  &trans  &trans  &trans
 &trans  &trans  &trans  &trans  &trans  &trans                                                  &trans  &trans  &trans  &trans  &trans  &trans
 &trans  &trans  &trans  &trans  &trans  &trans  &trans  &trans  &trans  &trans  &trans  &trans  &trans  &trans  &trans  &trans  &trans  &trans
 &trans  &trans  &trans  &trans  &trans          &trans  &trans  &trans  &trans  &trans  &trans          &trans  &trans  &trans  &trans  &trans
            >;
        };

        layer_MouseFast {
            bindings = <
 &trans  &trans  &trans  &trans  &trans                                                                  &trans  &trans  &trans  &trans  &trans
 &trans  &trans  &trans  &trans  &trans  &trans                                                  &trans  &trans  &trans  &trans  &trans  &trans
 &trans  &trans  &trans  &trans  &trans  &trans                                                  &trans  &trans  &trans  &trans  &trans  &trans
 &trans  &trans  &trans  &trans  &trans  &trans                                                  &trans  &trans  &trans  &trans  &trans  &trans
 &trans  &trans  &trans  &trans  &trans  &trans  &trans  &trans  &trans  &trans  &trans  &trans  &trans  &trans  &trans  &trans  &trans  &trans
 &trans  &trans  &trans  &trans  &trans          &trans  &trans  &trans  &trans  &trans  &trans          &trans  &trans  &trans  &trans  &trans
            >;
        };

        layer_MouseWarp {
            bindings = <
 &trans  &trans  &trans  &trans  &trans                                                                  &trans  &trans  &trans  &trans  &trans
 &trans  &trans  &trans  &trans  &trans  &trans                                                  &trans  &trans  &trans  &trans  &trans  &trans
 &trans  &trans  &trans  &trans  &trans  &trans                                                  &trans  &trans  &trans  &trans  &trans  &trans
 &trans  &trans  &trans  &trans  &trans  &trans                                                  &trans  &trans  &trans  &trans  &trans  &trans
 &trans  &trans  &trans  &trans  &trans  &trans  &trans  &trans  &trans  &trans  &trans  &trans  &trans  &trans  &trans  &trans  &trans  &trans
 &trans  &trans  &trans  &trans  &trans          &trans  &trans  &trans  &trans  &trans  &trans          &trans  &trans  &trans  &trans  &trans
            >;
        };

        layer_Lower {
            bindings = <
         &kp C_BRI_DN  &kp C_BRI_UP      &kp C_PREV      &kp C_NEXT         &kp C_PP                                                                         &kp C_MUTE  &kp C_VOL_DN  &kp C_VOL_UP            &none  &kp PAUSE_BREAK
               &trans         &none      &kp C_MUTE    &kp C_VOL_DN     &kp C_VOL_UP   &kp HOME                                                  &kp LS(N9)  &kp KP_NUM     &kp EQUAL  &kp KP_SLASH  &kp KP_MULTIPLY  &kp PRINTSCREEN
               &trans         &none           &none    &kp UP_ARROW            &none    &kp END                                                  &kp LS(N0)   &kp KP_N7     &kp KP_N8     &kp KP_N9     &kp KP_MINUS   &kp SCROLLLOCK
               &trans         &none  &kp LEFT_ARROW  &kp DOWN_ARROW  &kp RIGHT_ARROW  &kp PG_UP                                                  &kp LS(N5)   &kp KP_N4     &kp KP_N5     &kp KP_N6      &kp KP_PLUS            &none
               &trans     &kp K_APP           &none         &kp F11          &kp F12  &kp PG_DN  &trans  &trans   &to 0  &trans  &trans  &trans   &kp COMMA   &kp KP_N1     &kp KP_N2     &kp KP_N3     &kp KP_ENTER           &trans
 &magic LAYER_Magic 0      &kp CAPS         &kp INS         &kp F11          &kp F12             &trans  &trans  &trans  &trans  &trans  &trans               &kp KP_N0     &kp KP_N0    &kp KP_DOT     &kp KP_ENTER           &trans
            >;
        };

        layer_Magic {
            bindings = <
       &none            &none             &none            &none            &none                                                                                      &none   &none   &none  &bt BT_CLR  &bt BT_CLR_ALL
       &to 0            &none  &to LAYER_Typing            &none            &none  &to LAYER_Autoshift                                                         &none   &none   &none   &none       &none           &none
       &none  &rgb_ug RGB_SPI   &rgb_ug RGB_SAI  &rgb_ug RGB_HUI  &rgb_ug RGB_BRI      &rgb_ug RGB_TOG                                                         &none   &none   &none   &none       &none           &none
 &bootloader  &rgb_ug RGB_SPD   &rgb_ug RGB_SAD  &rgb_ug RGB_HUD  &rgb_ug RGB_BRD      &rgb_ug RGB_EFF                                                         &none   &none   &none   &none       &none     &bootloader
  &sys_reset            &none             &none            &none            &none                &none   &bt_2   &bt_3         &none   &none   &none   &none   &none   &none   &none   &none       &none      &sys_reset
       &none            &none             &none            &none            &none                        &bt_0   &bt_1  &out OUT_USB   &none   &none   &none           &none   &none   &none       &none           &none
            >;
        };

        layer_PySym {
            bindings = <
        &trans         &trans  &trans  &trans  &trans                                                                         &trans      &trans      &trans        &trans      &trans
        &trans         &trans  &trans  &trans  &trans  &trans                                                  &trans         &trans      &trans      &trans        &trans      &trans
    &kp LS(N8)  &kp LS(EQUAL)  &kp N9  &kp N8  &kp N7  &trans                                                  &trans  &kp LS(MINUS)  &kp LS(N9)    &kp LBKT  &kp LS(LBKT)  &kp LS(N5)
 &kp LS(COMMA)      &kp MINUS  &kp N6  &kp N5  &kp N4  &trans                                                  &trans       &kp FSLH  &kp LS(N0)    &kp RBKT  &kp LS(RBKT)      &trans
       &kp DOT         &kp N0  &kp N3  &kp N2  &kp N1  &trans  &trans  &trans  &trans  &trans  &trans  &trans  &trans       &kp BSLH   &kp EQUAL  &kp LS(N3)     &kp GRAVE      &trans
        &trans         &trans  &trans  &trans  &trans          &trans  &trans  &trans  &trans  &trans  &trans                 &trans      &trans      &trans        &trans      &trans
            >;
        };

    };
};


/ {
    underglow-layer {
        compatible = "zmk,underglow-layer";

        base {
            bindings = <
            &ug 0xe0e041 &ug 0xe0e041 &ug 0xe0e041 &ug 0xe0e041 &ug 0xe0e041 &ug 0xe0e041 &ug 0xe0e041 &ug 0xe0e041 &ug 0xe6ad65 &ug 0xe6ad65
            &ug 0xbb90ad &ug 0xe6ad65 &ug 0xe6ad65 &ug 0xe6ad65 &ug 0xe6ad65 &ug 0xe6ad65 &ug 0xe6ad65 &ug 0xe6ad65 &ug 0xe6ad65 &ug 0xe6ad65 &ug 0xe6ad65 &ug 0xbb90ad
            &ug 0x1c7ee0 &ug 0x1ce07e &ug 0x1ce07e &ug 0x1ce07e &ug 0x1ce07e &ug 0x1ce07e &ug 0x1ce07e &ug 0x1ce07e &ug 0x1ce07e &ug 0x1ce07e &ug 0x1ce07e &ug 0xbb90ad
            &ug 0xa4a48e &ug 0x1c7ee0 &ug 0x1c7ee0 &ug 0x1c7ee0 &ug 0x1c7ee0 &ug 0x1ce07e &ug 0xa4a48e &ug 0x1c7ee0 &ug 0x1c7ee0 &ug 0x1c7ee0 &ug 0x1c7ee0 &ug 0xbb90ad
            &ug 0xbb90ad &ug 0x1ce07e &ug 0x1ce07e &ug 0x1ce07e &ug 0x1ce07e &ug 0x1ce07e &ug 0xb753df &ug 0x1c7ee0 &ug 0xb753df &ug 0x1c7ee0 &ug 0x1c7ee0 &ug 0x1c7ee0
            &ug 0x1ce07e &ug 0x1ce07e &ug 0xbb90ad &ug 0xbb90ad &ug 0xbb90ad &ug 0xdc5a6c
            &ug 0xb753df &ug 0xdc5a6c &ug 0xdc5a6c &ug 0xdc5a6c &ug 0xdc5a6c &ug 0x1c7ee0
            &ug 0xb753df &ug 0x1ce07e &ug 0x1c7ee0 &ug 0xb753df &ug 0xb753df
            &ug 0xdc5a6c &ug 0xdc5a6c &ug 0xbb90ad &ug 0xbb90ad &ug 0xdc5a6c
            >;
            layer-id = <LAYER_HRM_macOS>;
        };

        cursor {
            bindings = <
            &ug BLACK &ug BLACK &ug BLACK &ug BLACK &ug BLACK &ug BLACK &ug BLACK &ug BLACK &ug BLACK &ug BLACK
            &ug BLACK &ug 0xa4a48e &ug 0xa4a48e &ug 0xa4a48e &ug 0xa4a48e &ug 0xa4a48e &ug BLACK &ug BLACK &ug BLACK &ug BLACK &ug BLACK &ug BLACK
            &ug BLACK &ug 0xe36969 &ug 0x1ce07e &ug 0x1c7ee0 &ug 0xa4a48e &ug 0xe36969 &ug 0xe36969 &ug 0x1c7ee0 &ug 0xe36969 &ug 0xe36969 &ug 0x1c7ee0 &ug BLACK
            &ug 0x1c7ee0 &ug 0x1c7ee0 &ug 0x1c7ee0 &ug 0x1c7ee0 &ug 0x1c7ee0 &ug 0xe36969 &ug 0xe36969 &ug 0xdc5a6c &ug 0xdc5a6c &ug 0xdc5a6c &ug 0xdc5a6c &ug 0x1c7ee0
            &ug 0xe36969 &ug 0xe36969 &ug 0xe36969 &ug 0xe36969 &ug 0xe36969 &ug 0xe36969 &ug BLACK &ug BLACK &ug BLACK &ug 0xe36969 &ug 0xe36969 &ug 0xe36969
            &ug 0xe36969 &ug 0xdc5a6c &ug 0xdc5a6c &ug 0xdc5a6c &ug 0xdc5a6c &ug 0xe36969
            &ug 0xe36969 &ug 0xe36969 &ug 0xe36969 &ug 0xe36969 &ug 0xe36969 &ug BLACK
            &ug BLACK &ug BLACK &ug 0xe36969 &ug 0xe36969 &ug 0xe36969
            &ug 0xe36969 &ug 0xe36969 &ug 0xe36969 &ug 0xe36969 &ug 0xe36969
            >;
            layer-id = <LAYER_Cursor>;
        };

        symbol {
            bindings = <
            &ug BLACK &ug BLACK &ug BLACK &ug BLACK &ug BLACK &ug BLACK &ug BLACK &ug BLACK &ug BLACK &ug BLACK
            &ug BLACK &ug 0xbb90ad &ug 0xbb90ad &ug 0xbb90ad &ug 0xbb90ad &ug 0xbb90ad &ug BLACK &ug BLACK &ug BLACK &ug BLACK &ug BLACK &ug BLACK
            &ug 0xbb90ad &ug 0xbb90ad &ug 0xbb90ad &ug 0xbb90ad &ug 0xbb90ad &ug 0xbb90ad &ug 0xbb90ad &ug 0xa4a48e &ug 0x1c7ee0 &ug 0xa4a48e &ug 0xa4a48e &ug BLACK
            &ug 0xbb90ad &ug 0xbb90ad &ug 0xbb90ad &ug 0xbb90ad &ug 0xbb90ad &ug 0xbb90ad &ug 0xbb90ad &ug 0xa4a48e &ug 0x1c7ee0 &ug 0x1ce07e &ug 0x1ce07e &ug BLACK
            &ug 0xbb90ad &ug 0xbb90ad &ug 0xbb90ad &ug 0xbb90ad &ug 0xbb90ad &ug 0xbb90ad &ug 0xbb90ad &ug 0xbb90ad &ug 0xbb90ad &ug BLACK &ug BLACK &ug BLACK
            &ug 0xbb90ad &ug 0xbb90ad &ug 0xbb90ad &ug 0xbb90ad &ug 0xbb90ad &ug BLACK
            &ug 0xbb90ad &ug 0xbb90ad &ug 0xbb90ad &ug 0xbb90ad &ug 0xbb90ad &ug 0xbb90ad
            &ug 0xbb90ad &ug 0xbb90ad &ug BLACK &ug BLACK &ug BLACK
            &ug 0x1c7ee0 &ug 0x1c7ee0 &ug 0x1c7ee0 &ug 0x1c7ee0 &ug BLACK
            >;
            layer-id = <LAYER_Symbol>;
        };

        mouse {
            bindings = <
            &ug BLACK &ug BLACK &ug BLACK &ug BLACK &ug BLACK &ug BLACK &ug BLACK &ug BLACK &ug BLACK &ug BLACK
            &ug BLACK &ug BLACK &ug BLACK &ug BLACK &ug BLACK &ug BLACK &ug BLACK &ug BLACK &ug BLACK &ug BLACK &ug BLACK &ug BLACK
            &ug BLACK &ug BLACK &ug 0x35bce9 &ug 0x35bce9 &ug 0x35bce9 &ug BLACK &ug 0x35bce9 &ug 0x41e091 &ug 0x41e091 &ug 0x41e091 &ug 0x35bce9 &ug BLACK
            &ug BLACK &ug 0x35bce9 &ug 0x35bce9 &ug 0x35bce9 &ug 0x35bce9 &ug 0x35bce9 &ug 0x35bce9 &ug 0xb753df &ug 0xb753df &ug 0xb753df &ug 0xa4a48e &ug 0x41e091
            &ug BLACK &ug 0x35bce9 &ug 0xb753df &ug 0xb753df &ug 0xb753df &ug 0x35bce9 &ug 0x41e091 &ug 0xa4a48e &ug 0x41e091 &ug 0xe36969 &ug 0xe36969 &ug 0xe36969
            &ug 0x35bce9 &ug 0x35bce9 &ug 0x35bce9 &ug 0x35bce9 &ug 0x35bce9 &ug 0x41e091
            &ug BLACK &ug BLACK &ug 0xe36969 &ug 0xe36969 &ug 0xe36969 &ug 0x41e091
            &ug 0x41e091 &ug 0x41e091 &ug BLACK &ug BLACK &ug BLACK
            &ug 0x1c7ee0 &ug 0x1c7ee0 &ug 0x1c7ee0 &ug 0x1c7ee0 &ug BLACK
            >;
            layer-id = <LAYER_Mouse>;
        };

        gaming {
            bindings = <
            &ug 0xa4a48e &ug 0x1ce07e &ug 0x1ce07e &ug 0x1ce07e &ug 0xa4a48e &ug 0xe6ad65 &ug 0xe6ad65 &ug 0xe6ad65 &ug 0xe6ad65 &ug 0xe6ad65
            &ug 0x1ce07e &ug 0xe6ad65 &ug 0xe6ad65 &ug 0xe6ad65 &ug 0xe6ad65 &ug 0xe6ad65 &ug 0xe6ad65 &ug 0xe6ad65 &ug 0xe6ad65 &ug 0xe6ad65 &ug 0xe6ad65 &ug 0xe6ad65
            &ug 0x1ce07e &ug 0xe6ad65 &ug 0xe6ad65 &ug 0xe6ad65 &ug 0xe6ad65 &ug 0xe6ad65 &ug 0x1ce07e &ug 0x1ce07e &ug 0x1ce07e &ug 0x1ce07e &ug 0x1ce07e &ug 0xe6ad65
            &ug 0x1ce07e &ug 0x1c7ee0 &ug 0x1ce07e &ug 0x78d478 &ug 0x1ce07e &ug 0x1ce07e &ug 0x1ce07e &ug 0x1ce07e &ug 0x1ce07e &ug 0x1ce07e &ug 0xbb90ad &ug 0xbb90ad
            &ug 0x1ce07e &ug 0x1c7ee0 &ug 0x78d478 &ug 0x78d478 &ug 0x78d478 &ug 0x1ce07e &ug 0x1c7ee0 &ug 0x1c7ee0 &ug 0x1ce07e &ug 0xa4a48e &ug 0xdc5a6c &ug 0xe36969
            &ug 0x1ce07e &ug 0x1ce07e &ug 0xbb90ad &ug 0xbb90ad &ug 0xbb90ad &ug 0xbb90ad
            &ug 0x1ce07e &ug 0x1c7ee0 &ug 0x1ce07e &ug 0x1ce07e &ug 0x1ce07e &ug 0x1ce07e
            &ug 0x1c7ee0 &ug 0xe36969 &ug 0xdc5a6c &ug 0xdc5a6c &ug 0xdc5a6c
            &ug 0xbb90ad &ug 0xbb90ad &ug 0xbb90ad &ug 0xbb90ad &ug 0xbb90ad
            >;
            layer-id = <LAYER_Gaming>;
        };

        lower {
            bindings = <
            &ug 0xe0e041 &ug 0xe0e041 &ug 0xe0e041 &ug 0xe0e041 &ug 0xe0e041 &ug 0xe0e041 &ug 0xe0e041 &ug 0xe0e041 &ug BLACK &ug 0xe0e041
            &ug BLACK &ug BLACK &ug 0xe0e041 &ug 0xe0e041 &ug 0xe0e041 &ug 0xdc5a6c &ug 0xbb90ad &ug 0xa4a48e &ug 0xbb90ad &ug 0xbb90ad &ug 0xbb90ad &ug 0xa4a48e
            &ug BLACK &ug BLACK &ug BLACK &ug 0xdc5a6c &ug BLACK &ug 0xdc5a6c &ug 0xbb90ad &ug 0xe6ad65 &ug 0xe6ad65 &ug 0xe6ad65 &ug 0xbb90ad &ug 0xa4a48e
            &ug BLACK &ug BLACK &ug 0xdc5a6c &ug 0xdc5a6c &ug 0xdc5a6c &ug 0xdc5a6c &ug 0xbb90ad &ug 0xe6ad65 &ug 0xe6ad65 &ug 0xe6ad65 &ug 0xbb90ad &ug BLACK
            &ug BLACK &ug 0xa4a48e &ug BLACK &ug 0xe6ad65 &ug 0xe6ad65 &ug 0xdc5a6c &ug BLACK &ug BLACK &ug 0xb753df &ug BLACK &ug BLACK &ug BLACK
            &ug 0xbb90ad &ug 0xe6ad65 &ug 0xe6ad65 &ug 0xe6ad65 &ug 0xe6ad65 &ug BLACK
            &ug 0xb753df &ug 0xa4a48e &ug 0xa4a48e &ug 0xe6ad65 &ug 0xe6ad65 &ug BLACK
            &ug BLACK &ug BLACK &ug BLACK &ug BLACK &ug BLACK
            &ug 0xe6ad65 &ug 0xe6ad65 &ug 0xe6ad65 &ug 0xe6ad65 &ug BLACK
            >;
            layer-id = <LAYER_Lower>;
        };

        magic {
            bindings = <
            &ug BLACK &ug BLACK &ug BLACK &ug BLACK &ug BLACK &ug BLACK &ug BLACK &ug BLACK &ug 0xe93535 &ug 0xe93535
            &ug 0xb753df &ug BLACK &ug 0xb753df &ug BLACK &ug BLACK &ug 0xb753df &ug BLACK &ug BLACK &ug BLACK &ug BLACK &ug BLACK &ug BLACK
            &ug BLACK &ug 0xe0e041 &ug 0xe0e041 &ug 0xe0e041 &ug 0xe0e041 &ug 0xe0e041 &ug BLACK &ug BLACK &ug BLACK &ug BLACK &ug BLACK &ug BLACK
            &ug 0xff4d4d &ug 0xe0e041 &ug 0xe0e041 &ug 0xe0e041 &ug 0xe0e041 &ug 0xe0e041 &ug BLACK &ug BLACK &ug BLACK &ug BLACK &ug BLACK &ug 0xff4d4d
            &ug 0xffac4d &ug BLACK &ug BLACK &ug BLACK &ug BLACK &ug BLACK &ug 0x3562e9 &ug 0x3562e9 &ug BLACK &ug BLACK &ug BLACK &ug BLACK
            &ug BLACK &ug BLACK &ug BLACK &ug BLACK &ug BLACK &ug 0xffac4d
            &ug BLACK &ug BLACK &ug BLACK &ug BLACK &ug BLACK &ug 0x3562e9
            &ug 0x3562e9 &ug 0xe0e041 &ug BLACK &ug BLACK &ug BLACK
            &ug BLACK &ug BLACK &ug BLACK &ug BLACK &ug BLACK
            >;
            layer-id = <LAYER_Magic>;
        };

        pysym {
            bindings = <
            &ug BLACK &ug BLACK &ug BLACK &ug BLACK &ug BLACK &ug BLACK &ug BLACK &ug BLACK &ug BLACK &ug BLACK
            &ug BLACK &ug BLACK &ug BLACK &ug BLACK &ug BLACK &ug BLACK &ug BLACK &ug BLACK &ug BLACK &ug BLACK &ug BLACK &ug BLACK
            &ug 0xbb90ad &ug 0xbb90ad &ug 0xe6ad65 &ug 0xe6ad65 &ug 0xe6ad65 &ug BLACK &ug BLACK &ug 0xbb90ad &ug 0xbb90ad &ug 0xbb90ad &ug 0xbb90ad &ug 0xbb90ad
            &ug 0xbb90ad &ug 0xbb90ad &ug 0xe6ad65 &ug 0xe6ad65 &ug 0xe6ad65 &ug BLACK &ug BLACK &ug 0xbb90ad &ug 0xbb90ad &ug 0xbb90ad &ug 0xbb90ad &ug BLACK
            &ug 0xbb90ad &ug 0xe6ad65 &ug 0xe6ad65 &ug 0xe6ad65 &ug 0xe6ad65 &ug BLACK &ug BLACK &ug BLACK &ug BLACK &ug BLACK &ug BLACK &ug BLACK
            &ug BLACK &ug 0xbb90ad &ug 0xbb90ad &ug 0xbb90ad &ug 0xbb90ad &ug BLACK
            &ug BLACK &ug BLACK &ug BLACK &ug BLACK &ug BLACK &ug BLACK
            &ug BLACK &ug BLACK &ug BLACK &ug BLACK &ug BLACK
            &ug BLACK &ug BLACK &ug BLACK &ug BLACK &ug BLACK
            >;
            layer-id = <LAYER_PySym>;
        };

    };
};
